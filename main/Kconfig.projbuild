## main/Kconfig.projbuild
```kconfig
menu "Wireless Helper (AA Trigger)"

    config AA_BT_DEVICE_NAME
        string "Bluetooth device name"
        default "ESP32 Wireless Helper"
        help
            Classic BT name advertised to phones.

    config AA_WIFI_SSID
        string "WiFi SSID (STA join + handshake)"
        default "AndroidAuto"
        help
            SSID the ESP joins as STA, and that is passed to the phone
            in WifiInfoResponse.

    config AA_WIFI_KEY
        string "WiFi passphrase"
        default "password123"
        help
            WPA2 passphrase for STA join and WifiInfoResponse.

    config AA_TCP_PORT
        int "Android Auto TCP port"
        range 1 65535
        default 5288
        help
            Port the phone should connect to on the knock source IP.

    config AA_KNOCK_PORT
        int "TCP knock listen port"
        range 1 65535
        default 5289
        help
            Port the headunit knocks (subnet scan finds this open).

    config AA_WAKE_HOLD_MS
        int "Wake poke hold time (ms)"
        range 1000 60000
        default 15000
        help
            How long to hold each one-shot HFP/HSP poke connection.

endmenu
```
